/* ------------------------------------------------------------------
* 本文件由 tools/gen_a2l.py 自动生成：地址来自 ELF 符号表，不要手工修改。
* 生成：tools/gen_a2l.py
* 工程：HPM5E31_XCP
* 传输：XCP on CAN CMD=0x555 RES/DAQ=0x556
* ------------------------------------------------------------------ */ ASAP2_VERSION 1 71
/begin PROJECT HPM5E31_XCP "hpm5e31_1 第二阶段 XCP 标定测量工程"
/begin HEADER "hpm5e31_1 第二阶段 XCP 标定测量工程" VERSION "1.0" PROJECT_NO PRJ1 /end HEADER
/begin MODULE xcp_can_daq "XCP on CAN 从站 + DAQ 测量（CAN0 0x555/0x556）"
/begin MOD_COMMON "" BYTE_ORDER MSB_LAST /* RISC-V 小端：低字节在前 */ ALIGNMENT_BYTE 1 ALIGNMENT_WORD 2 ALIGNMENT_LONG 4 ALIGNMENT_FLOAT32_IEEE 4 ALIGNMENT_FLOAT64_IEEE 8 ALIGNMENT_INT64 8 /end MOD_COMMON
/begin MOD_PAR ""
 /begin MEMORY_SEGMENT RAM "AXI SRAM .data/.bss" DATA RAM INTERN 0x01200000 0x40000 0 0 0 0 0 /end MEMORY_SEGMENT
 /begin MEMORY_SEGMENT FLASH "XIP NOR（只读）" DATA FLASH EXTERN 0x80000000 0x100000 0 0 0 0 0 /end MEMORY_SEGMENT
/end MOD_PAR
/begin RECORD_LAYOUT RL_FLOAT32 FNC_VALUES 1 FLOAT32_IEEE COLUMN_DIR DIRECT /end RECORD_LAYOUT
/begin RECORD_LAYOUT RL_SLONG FNC_VALUES 1 SLONG COLUMN_DIR DIRECT /end RECORD_LAYOUT
/begin RECORD_LAYOUT RL_UBYTE FNC_VALUES 1 UBYTE COLUMN_DIR DIRECT /end RECORD_LAYOUT
/begin RECORD_LAYOUT RL_ULONG FNC_VALUES 1 ULONG COLUMN_DIR DIRECT /end RECORD_LAYOUT
/begin RECORD_LAYOUT RL_UWORD FNC_VALUES 1 UWORD COLUMN_DIR DIRECT /end RECORD_LAYOUT
/begin COMPU_METHOD cm_ident "raw value" RAT_FUNC "%8.0" "" COEFFS 0 1 0 0 0 1 /end COMPU_METHOD
/* 恒等换算 */
/begin COMPU_METHOD cm_adc_volt "linear" RAT_FUNC "%8.1" "mV" COEFFS 0 0.0503548 0 0 0 1 /end COMPU_METHOD
/begin COMPU_METHOD cm_permille "linear" RAT_FUNC "%6.1" "%" COEFFS 0 0.1 0 0 0 1 /end COMPU_METHOD
/begin MEASUREMENT g_adc_raw "ADC0.IN1 原始值（PF26）" UWORD cm_adc_volt 0 0 0 3300 ECU_ADDRESS 0x01200E54 UNIT "mV" /end MEASUREMENT
/begin MEASUREMENT g_tick_cnt "1 kHz 事件计数（丢帧判定）" ULONG cm_ident 0 0 0 4.29497e+09 ECU_ADDRESS 0x01200E58 FORMAT "%10.0" /end MEASUREMENT
/begin MEASUREMENT g_pid_mid "PID 积分项（定点 1/1000）" SLONG cm_ident 0 0 -1.5e+06 1.5e+06 ECU_ADDRESS 0x01200E5C /end MEASUREMENT
/begin MEASUREMENT g_cpu_load_pm "主循环负载（千分比）" UWORD cm_permille 0 0 0 1000 ECU_ADDRESS 0x01200E60 UNIT "%" /end MEASUREMENT
/begin MEASUREMENT g_u8_cnt "1 kHz 计数低 8 位" UBYTE cm_ident 0 0 0 255 ECU_ADDRESS 0x01200E62 FORMAT "%3.0" /end MEASUREMENT
/begin CHARACTERISTIC g_kp "PID 比例增益" VALUE 0x01200224 RL_FLOAT32 0 cm_ident 0 10 FORMAT "%6.3" UNIT "-" /end CHARACTERISTIC
/begin CHARACTERISTIC g_ki "PID 积分增益" VALUE 0x01200228 RL_FLOAT32 0 cm_ident 0 20 FORMAT "%6.3" UNIT "1/s" /end CHARACTERISTIC
/begin IF_DATA XCP
 /begin PROTOCOL_LAYER 0x0104 0x08 0x08 0x00 0x08 0x08 0x00 0x00 0x00 0x00 BYTE_ORDER_MSB_LAST ADDRESS_GRANULARITY_BYTE OPTIONAL_CMD GET_COMM_MODE_INFO OPTIONAL_CMD GET_ID OPTIONAL_CMD SET_REQUEST OPTIONAL_CMD GET_SEED OPTIONAL_CMD UNLOCK OPTIONAL_CMD SET_MTA OPTIONAL_CMD UPLOAD OPTIONAL_CMD SHORT_UPLOAD OPTIONAL_CMD DOWNLOAD OPTIONAL_CMD MODIFY_BITS OPTIONAL_CMD SET_CAL_PAGE OPTIONAL_CMD GET_CAL_PAGE OPTIONAL_CMD GET_PAG_PROCESSOR_INFO OPTIONAL_CMD GET_SEGMENT_INFO OPTIONAL_CMD GET_PAGE_INFO OPTIONAL_CMD SET_DAQ_PTR OPTIONAL_CMD WRITE_DAQ OPTIONAL_CMD SET_DAQ_LIST_MODE OPTIONAL_CMD GET_DAQ_LIST_MODE OPTIONAL_CMD START_STOP_DAQ_LIST OPTIONAL_CMD START_STOP_SYNCH OPTIONAL_CMD GET_DAQ_CLOCK OPTIONAL_CMD GET_DAQ_PROCESSOR_INFO OPTIONAL_CMD GET_DAQ_RESOLUTION_INFO OPTIONAL_CMD GET_DAQ_EVENT_INFO OPTIONAL_CMD FREE_DAQ OPTIONAL_CMD ALLOC_DAQ OPTIONAL_CMD ALLOC_ODT OPTIONAL_CMD ALLOC_ODT_ENTRY COMMUNICATION_MODE_SUPPORTED BLOCK /end PROTOCOL_LAYER
 /begin DAQ DYNAMIC 0x4 0x0 OPTIMISATION_TYPE_DEFAULT ADDRESS_EXTENSION_FREE IDENTIFICATION_FIELD_TYPE_ABSOLUTE GRANULARITY_ODT_ENTRY_SIZE_DAQ_BYTE 0x7 OVERLOAD_INDICATION_EVENT PRESCALER_SUPPORTED /begin TIMESTAMP_SUPPORTED 0x1 SIZE_DWORD UNIT_1US /end TIMESTAMP_SUPPORTED /begin EVENT "EVT_1ms" "GPTMR 1 kHz 事件" 0x0 DAQ 0x4 0x1 1MS 0x0 /end EVENT /begin EVENT "EVT_10ms" "100 Hz 事件" 0x1 DAQ 0x4 0xA 1MS 0x1 /end EVENT /end DAQ
 /begin XCP_ON_CAN 0x100 CAN_ID_MASTER 0x555 CAN_ID_SLAVE 0x556 BAUDRATE 0x7A120 SAMPLE_POINT 0x57 SAMPLE_RATE SINGLE BTL_CYCLES 0xA0 SJW 0x1 /end XCP_ON_CAN
/end IF_DATA
/end MODULE
/end PROJECT
