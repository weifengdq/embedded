/* lin12.c — TC397 LIN x11 driver (ASCLIN LIN, polling, single-core).
 *
 * Design notes:
 * - iLLD IfxAsclin_Lin blocking APIs (receiveHeader/receiveResponse/...) loop
 *   forever until HW flags arrive, so they cannot be used for multi-node
 *   scripted tests on one core (master TX while slaves RX would deadlock).
 *   This driver therefore implements its own tick-timeout guarded primitives
 *   on top of the IfxAsclin_* flag helpers, mirroring the iLLD sequences.
 * - Transactions are master-driven and fully synchronous: arm slaves ->
 *   master header -> slaves check header -> arm slaves for response ->
 *   response TX -> receivers check response. Gaps are sub-ms, well inside
 *   the LIN response-space / response-timeout window (DATCON.RESPONSE=255).
 * - Chemistry: PID parity is generated by lin_pid(); HW checks parity on RX
 *   (LP flag) and checksum on response RX (LC flag, enhanced by default).
 */
#include "lin12.h"
#include "IfxAsclin_Lin.h"
#include "IfxAsclin_PinMap.h"
#include "IfxPort.h"
#include "IfxStm.h"
#include "IfxScuWdt.h"
#include <string.h>

extern volatile uint32 g_TickCount_1ms;

linChState_t g_lin[LIN_NUM];
float32 g_linBaud = 19200.0f;
/* mid-hold snapshot for lindomf forensics */
uint32 g_linHoldIOC = 0, g_linHoldIN = 0, g_linHoldOUT = 0;

/* ASCLIN SFR per logical LIN (LINn -> MODULE_ASCLINn). LIN0 unused. */
static Ifx_ASCLIN *const linSfr[LIN_NUM] = {
    &MODULE_ASCLIN0, &MODULE_ASCLIN1, &MODULE_ASCLIN2, &MODULE_ASCLIN3,
    &MODULE_ASCLIN4, &MODULE_ASCLIN5, &MODULE_ASCLIN6, &MODULE_ASCLIN7,
    &MODULE_ASCLIN8, &MODULE_ASCLIN9, &MODULE_ASCLIN10, &MODULE_ASCLIN11
};

static IfxAsclin_Lin linHandle[LIN_NUM];

/* Pin pairs, verified against IfxAsclin_PinMap_TC39xB_LFBGA292 (.h/.c).
 * LIN0 entry is a placeholder (never used for init). */
static const IfxAsclin_Lin_Pins linPins[LIN_NUM] = {
    {NULL_PTR, IfxPort_InputMode_pullUp, NULL_PTR, IfxPort_OutputMode_pushPull, IfxPort_PadDriver_cmosAutomotiveSpeed1}, /* LIN0 placeholder */
    {&IfxAsclin1_RXB_P15_5_IN,  IfxPort_InputMode_pullUp, &IfxAsclin1_TX_P15_4_OUT,  IfxPort_OutputMode_pushPull, IfxPort_PadDriver_cmosAutomotiveSpeed1}, /* LIN1 */
    {&IfxAsclin2_RXC_P02_10_IN, IfxPort_InputMode_pullUp, &IfxAsclin2_TX_P10_5_OUT,  IfxPort_OutputMode_pushPull, IfxPort_PadDriver_cmosAutomotiveSpeed1}, /* LIN2 */
    {&IfxAsclin3_RXC_P20_3_IN,  IfxPort_InputMode_pullUp, &IfxAsclin3_TX_P20_0_OUT,  IfxPort_OutputMode_pushPull, IfxPort_PadDriver_cmosAutomotiveSpeed1}, /* LIN3 */
    {&IfxAsclin4_RXA_P00_12_IN, IfxPort_InputMode_pullUp, &IfxAsclin4_TX_P00_9_OUT,  IfxPort_OutputMode_pushPull, IfxPort_PadDriver_cmosAutomotiveSpeed1}, /* LIN4 */
    {&IfxAsclin5_RXA_P00_6_IN,  IfxPort_InputMode_pullUp, &IfxAsclin5_TX_P00_7_OUT,  IfxPort_OutputMode_pushPull, IfxPort_PadDriver_cmosAutomotiveSpeed1}, /* LIN5 */
    {&IfxAsclin6_RXF_P23_1_IN,  IfxPort_InputMode_pullUp, &IfxAsclin6_TX_P23_5_OUT,  IfxPort_OutputMode_pushPull, IfxPort_PadDriver_cmosAutomotiveSpeed1}, /* LIN6 */
    {&IfxAsclin7_RXF_P22_4_IN,  IfxPort_InputMode_pullUp, &IfxAsclin7_TX_P22_1_OUT,  IfxPort_OutputMode_pushPull, IfxPort_PadDriver_cmosAutomotiveSpeed1}, /* LIN7 */
    {&IfxAsclin8_RXD_P33_6_IN,  IfxPort_InputMode_pullUp, &IfxAsclin8_TX_P34_5_OUT,  IfxPort_OutputMode_pushPull, IfxPort_PadDriver_cmosAutomotiveSpeed1}, /* LIN8 */
    {&IfxAsclin9_RXE_P20_6_IN,  IfxPort_InputMode_pullUp, &IfxAsclin9_TX_P01_7_OUT,  IfxPort_OutputMode_pushPull, IfxPort_PadDriver_cmosAutomotiveSpeed1}, /* LIN9 */
    {&IfxAsclin10_RXA_P00_4_IN, IfxPort_InputMode_pullUp, &IfxAsclin10_TX_P00_8_OUT, IfxPort_OutputMode_pushPull, IfxPort_PadDriver_cmosAutomotiveSpeed1}, /* LIN10 */
    {&IfxAsclin11_RXD_P21_1_IN, IfxPort_InputMode_pullUp, &IfxAsclin11_TX_P21_0_OUT, IfxPort_OutputMode_pushPull, IfxPort_PadDriver_cmosAutomotiveSpeed1}, /* LIN11 master */
};

/* ---------- TLIN1024 EN (= board SLP_N, high = normal) ---------- */
void lin_xcvr_init(void)
{
    IfxPort_setPinModeOutput(&MODULE_P02, 8, IfxPort_OutputMode_pushPull, IfxPort_OutputIdx_general);
    IfxPort_setPinHigh(&MODULE_P02, 8);    /* LIN0-3 */
    IfxPort_setPinModeOutput(&MODULE_P00, 11, IfxPort_OutputMode_pushPull, IfxPort_OutputIdx_general);
    IfxPort_setPinHigh(&MODULE_P00, 11);   /* LIN4-7 */
    IfxPort_setPinModeOutput(&MODULE_P00, 10, IfxPort_OutputMode_pushPull, IfxPort_OutputIdx_general);
    IfxPort_setPinHigh(&MODULE_P00, 10);   /* LIN8-11 */
}

void lin_xcvr_set_group(uint8 group, uint8 normal)
{
    IfxPort_State st = normal ? IfxPort_State_high : IfxPort_State_low;
    if (group == 0)      IfxPort_setPinState(&MODULE_P02, 8, st);
    else if (group == 1) IfxPort_setPinState(&MODULE_P00, 11, st);
    else if (group == 2) IfxPort_setPinState(&MODULE_P00, 10, st);
}

void lin_xcvr_set_all(uint8 normal)
{
    lin_xcvr_set_group(0, normal);
    lin_xcvr_set_group(1, normal);
    lin_xcvr_set_group(2, normal);
}

/* ---------- PID helpers ---------- */
uint8 lin_pid(uint8 id6)
{
    uint8 id = id6 & 0x3FU;
    uint8 p0 = ((id >> 0) & 1) ^ ((id >> 1) & 1) ^ ((id >> 2) & 1) ^ ((id >> 4) & 1);
    uint8 p1 = ~(((id >> 1) & 1) ^ ((id >> 3) & 1) ^ ((id >> 4) & 1) ^ ((id >> 5) & 1)) & 1;
    return (uint8)(id | (p0 << 6) | (p1 << 7));
}

uint8 lin_id6(uint8 pid)
{
    return pid & 0x3FU;
}

sint8 lin_pid_check(uint8 pid)
{
    return (lin_pid(pid & 0x3FU) == pid) ? 0 : -1;
}

/* ---------- init ---------- */
/* Same set as the proven TC387 uart8lin reference (lin_enable_polling_flags):
 * in polling mode the LIN event flags must be explicitly enabled, otherwise
 * e.g. RHE/RRE never latch and slaves time out. Called after initModule
 * (which leaves FLAGSENABLE=0 in polling mode). */
static void lin_enable_polling_flags(Ifx_ASCLIN *sfr)
{
    IfxAsclin_enableBreakDetectedFlag(sfr, TRUE);
    IfxAsclin_enableCollisionDetectionErrorFlag(sfr, TRUE);
    IfxAsclin_enableFrameErrorFlag(sfr, TRUE);
    IfxAsclin_enableHeaderTimeoutFlag(sfr, TRUE);
    IfxAsclin_enableLinAutoBaudDetectionErrorFlag(sfr, TRUE);
    IfxAsclin_enableLinChecksumErrorFlag(sfr, TRUE);
    IfxAsclin_enableLinParityErrorFlag(sfr, TRUE);
    IfxAsclin_enableResponseTimeoutFlag(sfr, TRUE);
    IfxAsclin_enableRxFifoOverflowFlag(sfr, TRUE);
    IfxAsclin_enableRxHeaderEndFlag(sfr, TRUE);
    IfxAsclin_enableRxResponseEndFlag(sfr, TRUE);
    IfxAsclin_enableTxHeaderEndFlag(sfr, TRUE);
    IfxAsclin_enableTxResponseEndFlag(sfr, TRUE);
    IfxAsclin_enableTxFifoOverflowFlag(sfr, TRUE);
}

static void lin_init_channel(linChannel ch, float32 baud, uint8 isMaster)
{
    IfxAsclin_Lin_Config cfg;

    /* NOTE: no KRST here — a kernel reset hung the boot (RSTSTAT never set,
     * board silent until reflash). ASCLIN init alone is sufficient. */
    /* Match the proven TC387 reference: disable before (re-)init. */
    if (linHandle[ch].asclin != NULL) {
        IfxAsclin_Lin_disableModule(&linHandle[ch]);
    }
    IfxAsclin_Lin_initModuleConfig(&cfg, linSfr[ch]);
    cfg.linMode = isMaster ? IfxAsclin_LinMode_master : IfxAsclin_LinMode_slave;
    cfg.brg.baudrate = baud;
    /* keep iLLD LIN defaults: prescaler 4 / OS16 / 1 sample / SP3,
     * enhanced checksum, HW checksum on, response timeout 255. */
    cfg.brd.abd = FALSE;
    cfg.pins = &linPins[ch];
    /* RxSel (a..g) == ALTI 0..6: derive from the pin struct itself. */
    cfg.alti = (IfxAsclin_RxInputSelect)linPins[ch].rx->select;
    cfg.isInterruptMode = FALSE;
    /* Break: master generates 16 bits (margin over the 13-bit minimum),
     * slaves detect at 11 bits (LIN-compliant window). iLLD 13/13 default
     * proved marginal on this board (TLIN1024 edges + FDR rounding):
     * slaves saw FED/RED but never BD/RHE with a 13-bit master break,
     * while a 14-bit bit-banged break decoded fine. */
    cfg.lin.breakLength = isMaster ? 16 : 11;
    IfxAsclin_Lin_initModule(&linHandle[ch], &cfg);
    lin_enable_polling_flags(linSfr[ch]);

    g_lin[ch].used = 1;
    g_lin[ch].isMaster = isMaster;
}

void lin12_init_all(float32 baud)
{
    linChannel ch;
    if (baud < 1000.0f) baud = 19200.0f;
    g_linBaud = baud;
    memset(g_lin, 0, sizeof(g_lin));
    /* LIN0 intentionally skipped (ASCLIN0 = UART0 debug console).
     * Default masters: LIN3 (bus A: 1-2-3), LIN7 (bus B: 4-5-6-7),
     * LIN11 (bus C: 8-9-10-11); all others slave. */
    for (ch = LIN1; ch < LIN_NUM; ch++) {
        uint8 isMaster = (ch == LIN3 || ch == LIN7 || ch == LIN_MASTER_CH) ? 1 : 0;
        lin_init_channel(ch, baud, isMaster);
    }
}

void lin12_init_all_19200(void)
{
    lin12_init_all(19200.0f);
}


/* ---------- timeout-guarded primitives ---------- */
#define LIN_HDR_TIMEOUT_MS   50u
#define LIN_RESP_TIMEOUT_MS  100u

static uint32 lin_elapsed(uint32 t0);
static int lin_tx_header(Ifx_ASCLIN *sfr, uint8 pid, linChState_t *st);
static int lin_tx_response(Ifx_ASCLIN *sfr, const uint8 *data, uint8 len,
                           uint8 classic, linChState_t *st);
static void lin_arm_header(Ifx_ASCLIN *sfr);
static int lin_poll_header(Ifx_ASCLIN *sfr, uint8 *pid, linChState_t *st);
static void lin_arm_response(Ifx_ASCLIN *sfr, uint8 len, uint8 classic);
static int lin_poll_response(Ifx_ASCLIN *sfr, uint8 *data, uint8 len,
                             linChState_t *st);

static uint32 lin_elapsed(uint32 t0)
{
    return g_TickCount_1ms - t0;
}

/* Master/slave header TX (master role): write PID, request header, poll THE. */
static int lin_tx_header(Ifx_ASCLIN *sfr, uint8 pid, linChState_t *st)
{
    uint32 t0;
    uint8 b = pid;
    IfxAsclin_clearAllFlags(sfr);
    IfxAsclin_enableRxFifoInlet(sfr, FALSE);
    IfxAsclin_flushTxFifo(sfr);
    IfxAsclin_enableTxFifoOutlet(sfr, TRUE);
    IfxAsclin_write8(sfr, &b, 1U);
    IfxAsclin_setTransmitHeaderRequestFlag(sfr);
    t0 = g_TickCount_1ms;
    while (!IfxAsclin_getTxHeaderEndFlagStatus(sfr)) {
        if (IfxAsclin_getHeaderTimeoutFlagStatus(sfr) ||
            IfxAsclin_getLinParityErrorFlagStatus(sfr) ||
            IfxAsclin_getFrameErrorFlagStatus(sfr) ||
            IfxAsclin_getCollisionDetectionErrorFlagStatus(sfr)) {
            break;
        }
        if (lin_elapsed(t0) > LIN_HDR_TIMEOUT_MS) break;
    }
    if (IfxAsclin_getTxHeaderEndFlagStatus(sfr)) {
        IfxAsclin_clearTxHeaderEndFlag(sfr);
        if (st) st->txHdr++;
        return 0;
    }
    /* classify */
    if (st) {
        st->hdrErr++;
        if (IfxAsclin_getHeaderTimeoutFlagStatus(sfr)) st->timeoutErr++;
        if (IfxAsclin_getLinParityErrorFlagStatus(sfr)) st->parityErr++;
        if (IfxAsclin_getFrameErrorFlagStatus(sfr) ||
            IfxAsclin_getCollisionDetectionErrorFlagStatus(sfr)) st->frameErr++;
        if (!IfxAsclin_getHeaderTimeoutFlagStatus(sfr) &&
            !IfxAsclin_getLinParityErrorFlagStatus(sfr) &&
            !IfxAsclin_getFrameErrorFlagStatus(sfr) &&
            !IfxAsclin_getCollisionDetectionErrorFlagStatus(sfr)) st->timeoutErr++;
    }
    IfxAsclin_clearAllFlags(sfr);
    return -1;
}

/* Response TX (either role): DATLEN + checksum mode, write data, poll TRE. */
static int lin_tx_response(Ifx_ASCLIN *sfr, const uint8 *data, uint8 len,
                           uint8 classic, linChState_t *st)
{
    uint32 t0;
    if (len < 1) len = 1;
    if (len > 8) len = 8;
    IfxAsclin_setDataLength(sfr, (IfxAsclin_DataLength)(len - 1));
    IfxAsclin_setChecksumMode(sfr, classic ? IfxAsclin_Checksum_classic : IfxAsclin_Checksum_enhanced);
    IfxAsclin_clearAllFlags(sfr);
    IfxAsclin_flushTxFifo(sfr);
    IfxAsclin_enableRxFifoInlet(sfr, FALSE);
    IfxAsclin_enableTxFifoOutlet(sfr, TRUE);
    IfxAsclin_write8(sfr, (uint8 *)data, len);
    IfxAsclin_setTransmitResponseRequestFlag(sfr);
    t0 = g_TickCount_1ms;
    while (!IfxAsclin_getTxResponseEndFlagStatus(sfr)) {
        if (IfxAsclin_getResponseTimeoutFlagStatus(sfr) ||
            IfxAsclin_getTxFifoOverflowFlagStatus(sfr) ||
            IfxAsclin_getCollisionDetectionErrorFlagStatus(sfr) ||
            IfxAsclin_getBreakDetectedFlagStatus(sfr)) {
            break;
        }
        if (lin_elapsed(t0) > LIN_RESP_TIMEOUT_MS) break;
    }
    if (IfxAsclin_getTxResponseEndFlagStatus(sfr)) {
        IfxAsclin_clearTxResponseEndFlag(sfr);
        if (st) st->txResp++;
        return 0;
    }
    if (st) {
        st->respErr++;
        if (IfxAsclin_getResponseTimeoutFlagStatus(sfr)) st->timeoutErr++;
        else if (IfxAsclin_getCollisionDetectionErrorFlagStatus(sfr) ||
                 IfxAsclin_getBreakDetectedFlagStatus(sfr) ||
                 IfxAsclin_getTxFifoOverflowFlagStatus(sfr)) st->frameErr++;
        else st->timeoutErr++;
    }
    IfxAsclin_clearAllFlags(sfr);
    return -1;
}

/* Arm header RX (either role): mirror of IfxAsclin_Lin_prepareHeaderReception. */
static void lin_arm_header(Ifx_ASCLIN *sfr)
{
    IfxAsclin_clearAllFlags(sfr);
    IfxAsclin_flushRxFifo(sfr);
    IfxAsclin_enableTxFifoOutlet(sfr, FALSE);
    IfxAsclin_enableRxFifoInlet(sfr, TRUE);
}

/* Poll header RX with timeout. Returns 0 + pid on success. */
static int lin_poll_header(Ifx_ASCLIN *sfr, uint8 *pid, linChState_t *st)
{
    uint32 t0 = g_TickCount_1ms;
    while (!IfxAsclin_getRxHeaderEndFlagStatus(sfr)) {
        if (IfxAsclin_getHeaderTimeoutFlagStatus(sfr) ||
            IfxAsclin_getCollisionDetectionErrorFlagStatus(sfr) ||
            IfxAsclin_getFrameErrorFlagStatus(sfr) ||
            IfxAsclin_getLinAutoBaudDetectionErrorFlagStatus(sfr) ||
            IfxAsclin_getLinParityErrorFlagStatus(sfr)) {
            break;
        }
        if (lin_elapsed(t0) > LIN_HDR_TIMEOUT_MS) break;
    }
    if (IfxAsclin_getRxHeaderEndFlagStatus(sfr)) {
        uint8 b = 0;
        IfxAsclin_clearRxHeaderEndFlag(sfr);
        IfxAsclin_read8(sfr, &b, 1U);
        if (pid) *pid = b;
        if (st) st->rxHdr++;
        if (st && IfxAsclin_getLinParityErrorFlagStatus(sfr)) {
            /* latched alongside RHE on some revisions: count, keep frame */
            st->parityErr++;
        }
        return 0;
    }
    if (st) {
        st->hdrErr++;
        if (IfxAsclin_getHeaderTimeoutFlagStatus(sfr)) st->timeoutErr++;
        else if (IfxAsclin_getLinParityErrorFlagStatus(sfr)) st->parityErr++;
        else if (IfxAsclin_getFrameErrorFlagStatus(sfr) ||
                 IfxAsclin_getCollisionDetectionErrorFlagStatus(sfr)) st->frameErr++;
        else st->timeoutErr++;
    }
    IfxAsclin_clearAllFlags(sfr);
    return -1;
}

/* Arm response RX: mirror of IfxAsclin_Lin_prepareResponseReception. */
static void lin_arm_response(Ifx_ASCLIN *sfr, uint8 len, uint8 classic)
{
    if (len < 1) len = 1;
    if (len > 8) len = 8;
    IfxAsclin_setDataLength(sfr, (IfxAsclin_DataLength)(len - 1));
    IfxAsclin_setChecksumMode(sfr, classic ? IfxAsclin_Checksum_classic : IfxAsclin_Checksum_enhanced);
    IfxAsclin_clearAllFlags(sfr);
    IfxAsclin_flushRxFifo(sfr);
    IfxAsclin_enableTxFifoOutlet(sfr, FALSE);
    IfxAsclin_enableRxFifoInlet(sfr, TRUE);
}

/* Poll response RX with timeout. Returns 0 + data on success. */
static int lin_poll_response(Ifx_ASCLIN *sfr, uint8 *data, uint8 len,
                             linChState_t *st)
{
    uint32 t0 = g_TickCount_1ms;
    if (len < 1) len = 1;
    if (len > 8) len = 8;
    while (!IfxAsclin_getRxResponseEndFlagStatus(sfr)) {
        if (IfxAsclin_getRxFifoOverflowFlagStatus(sfr) ||
            IfxAsclin_getCollisionDetectionErrorFlagStatus(sfr) ||
            IfxAsclin_getFrameErrorFlagStatus(sfr) ||
            IfxAsclin_getLinChecksumErrorFlagStatus(sfr) ||
            IfxAsclin_getResponseTimeoutFlagStatus(sfr) ||
            IfxAsclin_getBreakDetectedFlagStatus(sfr)) {
            break;
        }
        if (lin_elapsed(t0) > LIN_RESP_TIMEOUT_MS) break;
    }
    if (IfxAsclin_getRxResponseEndFlagStatus(sfr)) {
        IfxAsclin_clearRxResponseEndFlag(sfr);
        IfxAsclin_read8(sfr, data, len);
        if (st) st->rxResp++;
        return 0;
    }
    if (st) {
        st->respErr++;
        if (IfxAsclin_getLinChecksumErrorFlagStatus(sfr)) st->cksumErr++;
        else if (IfxAsclin_getResponseTimeoutFlagStatus(sfr)) st->timeoutErr++;
        else if (IfxAsclin_getFrameErrorFlagStatus(sfr) ||
                 IfxAsclin_getCollisionDetectionErrorFlagStatus(sfr) ||
                 IfxAsclin_getRxFifoOverflowFlagStatus(sfr)) st->frameErr++;
        else st->timeoutErr++;
    }
    IfxAsclin_clearAllFlags(sfr);
    return -1;
}

int lin_set_role(linChannel ch, uint8 isMaster)
{
    if (ch < LIN1 || ch > LIN11) return -1;
    lin_init_channel(ch, g_linBaud, isMaster ? 1 : 0);
    return 0;
}

void lin_all_slave(void)
{
    linChannel ch;
    for (ch = LIN1; ch <= LIN11; ch++) {
        lin_init_channel(ch, g_linBaud, 0);
    }
}

/* External-master sniff: all LIN1..LIN11 listen for one header+response.
 * Raw-monitor style (mirrors the proven TC387 uart8lin reference which
 * passed full-receive tests): the response is captured with DATLEN=9 and
 * HW checksum OFF, so no length/checksum assumption is needed; the payload
 * is validated by the caller against the known analyzer frames.
 * Timing: header and response arrive back-to-back from the external master,
 * so after the first RHE latch we do exactly one more full scan pass (catch
 * late latchers on the same bus, ~us apart) and immediately arm responses.
 * No extra ms-scale wait: that would miss the response already on the bus. */
uint8 lin_checksum(uint8 pid, const uint8 *data, uint8 len, uint8 classic)
{
    uint32 sum = 0;
    uint8 i;
    if (!classic) sum += pid;
    for (i = 0; i < len; i++) sum += data[i];
    while (sum > 255u) sum -= 255u;
    return (uint8)(~sum & 0xFFu);
}

/* Normal slave response registers (iLLD defaults, also used by pairwise). */
static void lin_apply_normal_response(Ifx_ASCLIN *sfr)
{
    IfxAsclin_setChecksumInjection(sfr, IfxAsclin_ChecksumInjection_written);
    IfxAsclin_enableHardwareChecksum(sfr, TRUE);
    IfxAsclin_setLinResponseTimeoutMode(sfr, IfxAsclin_LinResponseTimeoutMode_frameTimeout);
    IfxAsclin_setLinResponseTimeoutThreshold(sfr, 255U);
    IfxAsclin_setHeaderResponseSelect(sfr, IfxAsclin_HeaderResponseSelect_headerAndResponse);
}

/* Raw-monitor response registers (TC387 uart8lin reference). */
static void lin_apply_raw_response(Ifx_ASCLIN *sfr)
{
    IfxAsclin_setChecksumInjection(sfr, IfxAsclin_ChecksumInjection_written);
    IfxAsclin_enableHardwareChecksum(sfr, FALSE);
    IfxAsclin_setDataLength(sfr, IfxAsclin_DataLength_9);
    IfxAsclin_setLinResponseTimeoutMode(sfr, IfxAsclin_LinResponseTimeoutMode_responseTimeout);
    IfxAsclin_setLinResponseTimeoutThreshold(sfr, 128U);
}

int lin_sniff_ext_frame(uint8 *pidOut, uint8 *expLen, uint8 *classicUsed,
                        uint32 *hdrMask, uint32 *respMask,
                        uint8 data[LIN_NUM][10], uint8 rawLen[LIN_NUM],
                        uint32 timeoutMs)
{
    linChannel ch;
    uint32 t0, hdr = 0, done = 0, okm = 0;
    uint8 pids[LIN_NUM];
    uint8 pidFirst = 0, firstSeen = 0;
    uint8 id6 = 0, exp = 8, classic = 0, expRaw = 9;
    uint8 acc[LIN_NUM][10];
    uint8 accN[LIN_NUM];
    int i;

    if (timeoutMs < 500u) timeoutMs = 500u;
    if (timeoutMs > 10000u) timeoutMs = 10000u;
    memset(pids, 0, sizeof(pids));
    memset(acc, 0, sizeof(acc));
    memset(accN, 0, sizeof(accN));
    if (data) memset(data, 0, LIN_NUM * 10u);
    if (rawLen) memset(rawLen, 0, LIN_NUM);

    /* 1) normal registers + arm all for header */
    for (ch = LIN1; ch <= LIN11; ch++) {
        lin_apply_normal_response(linSfr[ch]);
        lin_arm_header(linSfr[ch]);
    }

    /* 2) wait for external header (RHE latches per channel, poll round-robin) */
    t0 = g_TickCount_1ms;
    while ((g_TickCount_1ms - t0) < timeoutMs) {
        for (ch = LIN1; ch <= LIN11; ch++) {
            Ifx_ASCLIN *sfr;
            if (hdr & (1u << ch)) continue;
            sfr = linSfr[ch];
            if (IfxAsclin_getRxHeaderEndFlagStatus(sfr)) {
                uint8 b = 0;
                IfxAsclin_clearRxHeaderEndFlag(sfr);
                IfxAsclin_read8(sfr, &b, 1U);
                pids[ch] = b;
                hdr |= (1u << ch);
                g_lin[ch].rxHdr++;
                if (IfxAsclin_getLinParityErrorFlagStatus(sfr)) g_lin[ch].parityErr++;
                if (!firstSeen) { pidFirst = b; firstSeen = 1; }
                IfxAsclin_clearAllFlags(sfr);
            } else if (IfxAsclin_getHeaderTimeoutFlagStatus(sfr) ||
                       IfxAsclin_getFrameErrorFlagStatus(sfr) ||
                       IfxAsclin_getCollisionDetectionErrorFlagStatus(sfr) ||
                       IfxAsclin_getLinParityErrorFlagStatus(sfr)) {
                /* header error latched before RHE: count once, re-arm so a
                 * later frame in the same window can still be caught */
                g_lin[ch].hdrErr++;
                if (IfxAsclin_getLinParityErrorFlagStatus(sfr)) g_lin[ch].parityErr++;
                else if (IfxAsclin_getHeaderTimeoutFlagStatus(sfr)) g_lin[ch].timeoutErr++;
                else g_lin[ch].frameErr++;
                IfxAsclin_clearAllFlags(sfr);
                lin_arm_header(sfr);
            }
        }
        if (hdr) break; /* first pass with any hit: one more pass below */
    }
    if (!hdr) {
        if (hdrMask) *hdrMask = 0;
        if (respMask) *respMask = 0;
        return -1;
    }
    /* one more scan pass for same-bus late latchers (no ms wait) */
    for (ch = LIN1; ch <= LIN11; ch++) {
        Ifx_ASCLIN *sfr;
        if (hdr & (1u << ch)) continue;
        sfr = linSfr[ch];
        if (IfxAsclin_getRxHeaderEndFlagStatus(sfr)) {
            uint8 b = 0;
            IfxAsclin_clearRxHeaderEndFlag(sfr);
            IfxAsclin_read8(sfr, &b, 1U);
            pids[ch] = b;
            hdr |= (1u << ch);
            g_lin[ch].rxHdr++;
            if (IfxAsclin_getLinParityErrorFlagStatus(sfr)) g_lin[ch].parityErr++;
            IfxAsclin_clearAllFlags(sfr);
        }
    }

    /* 3) expected payload from first PID */
    id6 = pidFirst & 0x3FU;
    if (id6 == 0x17) { exp = 2; classic = 1; expRaw = 3; }
    else if (id6 == 0x31) { exp = 8; classic = 0; expRaw = 9; }
    else if (id6 >= 0x3C) { exp = 8; classic = 1; expRaw = 9; }
    else { exp = 8; classic = 0; expRaw = 9; }
    if (pidOut) *pidOut = pidFirst;
    if (expLen) *expLen = exp;
    if (classicUsed) *classicUsed = classic;
    if (hdrMask) *hdrMask = hdr;

    /* 4) arm header-hit channels for raw response capture */
    for (ch = LIN1; ch <= LIN11; ch++) {
        Ifx_ASCLIN *sfr;
        if (!(hdr & (1u << ch))) continue;
        sfr = linSfr[ch];
        lin_apply_raw_response(sfr);
        IfxAsclin_clearAllFlags(sfr);
        IfxAsclin_flushRxFifo(sfr);
        IfxAsclin_enableTxFifoOutlet(sfr, FALSE);
        IfxAsclin_enableRxFifoInlet(sfr, TRUE);
    }

    /* 5) capture: drain FIFO continuously, finish per channel on RRE (full
     * 9B), RT (short frame done, e.g. 2B+CK), or bus error / next break. */
    t0 = g_TickCount_1ms;
    while ((g_TickCount_1ms - t0) < 500u) {
        for (ch = LIN1; ch <= LIN11; ch++) {
            Ifx_ASCLIN *sfr;
            uint8 n;
            if (!(hdr & (1u << ch))) continue;
            if (done & (1u << ch)) continue;
            sfr = linSfr[ch];
            /* drain whatever arrived */
            for (;;) {
                n = IfxAsclin_getRxFifoFillLevel(sfr);
                if (n == 0) break;
                if (n > 10u) n = 10u;
                {
                    uint8 tmp[10];
                    uint8 k, take;
                    if (n > 10u) n = 10u;
                    IfxAsclin_read8(sfr, tmp, n);
                    take = (uint8)(10u - accN[ch]);
                    if (take > n) take = n;
                    for (k = 0; k < take; k++) acc[ch][accN[ch] + k] = tmp[k];
                    accN[ch] = (uint8)(accN[ch] + take);
                }
            }
            if (IfxAsclin_getRxResponseEndFlagStatus(sfr) ||
                IfxAsclin_getResponseTimeoutFlagStatus(sfr) ||
                IfxAsclin_getFrameErrorFlagStatus(sfr) ||
                IfxAsclin_getCollisionDetectionErrorFlagStatus(sfr) ||
                IfxAsclin_getRxFifoOverflowFlagStatus(sfr) ||
                IfxAsclin_getBreakDetectedFlagStatus(sfr)) {
                /* one final drain after the end flag */
                for (;;) {
                    n = IfxAsclin_getRxFifoFillLevel(sfr);
                    if (n == 0) break;
                    if (n > 10u) n = 10u;
                    {
                        uint8 tmp[10];
                        uint8 k, take;
                        IfxAsclin_read8(sfr, tmp, n);
                        take = (uint8)(10u - accN[ch]);
                        if (take > n) take = n;
                        for (k = 0; k < take; k++) acc[ch][accN[ch] + k] = tmp[k];
                        accN[ch] = (uint8)(accN[ch] + take);
                    }
                }
                if (IfxAsclin_getFrameErrorFlagStatus(sfr) ||
                    IfxAsclin_getCollisionDetectionErrorFlagStatus(sfr) ||
                    IfxAsclin_getRxFifoOverflowFlagStatus(sfr)) {
                    g_lin[ch].respErr++;
                    g_lin[ch].frameErr++;
                    g_lin[ch].lastOk = 0;
                } else {
                    /* RRE / RT / next-break: captured bytes are the frame */
                    g_lin[ch].rxResp++;
                    if (accN[ch] == expRaw) {
                        okm |= (1u << ch);
                        g_lin[ch].lastId = id6;
                        g_lin[ch].lastLen = (exp > 8) ? 8 : exp;
                        for (i = 0; i < g_lin[ch].lastLen; i++) {
                            g_lin[ch].lastData[i] = acc[ch][i];
                        }
                        g_lin[ch].lastClassic = classic ? 1 : 0;
                        g_lin[ch].lastDir = 0;
                        g_lin[ch].lastTick = g_TickCount_1ms;
                        g_lin[ch].lastOk = 1;
                    } else {
                        g_lin[ch].respErr++;
                        g_lin[ch].timeoutErr++;
                        g_lin[ch].lastOk = 0;
                    }
                    if (IfxAsclin_getLinChecksumErrorFlagStatus(sfr)) {
                        /* HW checksum is OFF in raw mode; ignore if set */
                    }
                }
                IfxAsclin_clearAllFlags(sfr);
                done |= (1u << ch);
            }
        }
        if ((done & hdr) == hdr) break;
    }
    /* still pending -> timeout */
    for (ch = LIN1; ch <= LIN11; ch++) {
        if ((hdr & (1u << ch)) && !(done & (1u << ch))) {
            g_lin[ch].respErr++;
            g_lin[ch].timeoutErr++;
            g_lin[ch].lastOk = 0;
            IfxAsclin_clearAllFlags(linSfr[ch]);
            done |= (1u << ch);
        }
        /* restore normal registers for the next command */
        if (hdr & (1u << ch)) lin_apply_normal_response(linSfr[ch]);
        if (rawLen) rawLen[ch] = accN[ch];
        if (data) for (i = 0; i < 10; i++) data[ch][i] = acc[ch][i];
    }
    if (respMask) *respMask = okm;
    if (okm) return 0;
    return -2;
}

/* Pairwise master -> slave (header + response from master, slave verifies). */
int lin_xact_m2s(linChannel master, linChannel slave, uint8 id6,
                 const uint8 *data, uint8 len, uint8 classic)
{
    uint8 pid = lin_pid(id6);
    uint8 rxPid = 0, rxData[8];
    int i;

    if (master < LIN1 || master > LIN11 || slave < LIN1 || slave > LIN11) return -1;
    if (len < 1) len = 1;
    if (len > 8) len = 8;

    lin_arm_header(linSfr[slave]);
    if (lin_tx_header(linSfr[master], pid, &g_lin[master]) != 0) return -1;
    if (lin_poll_header(linSfr[slave], &rxPid, &g_lin[slave]) != 0 || rxPid != pid) return -1;
    lin_arm_response(linSfr[slave], len, classic);
    if (lin_tx_response(linSfr[master], data, len, classic, &g_lin[master]) != 0) {
        g_lin[slave].respErr++;
        return -1;
    }
    memset(rxData, 0, sizeof(rxData));
    if (lin_poll_response(linSfr[slave], rxData, len, &g_lin[slave]) != 0) return -1;
    for (i = 0; i < len; i++) {
        if (rxData[i] != data[i]) {
            g_lin[slave].respErr++;
            return -1;
        }
    }
    g_lin[slave].lastId = id6 & 0x3FU;
    g_lin[slave].lastLen = len;
    for (i = 0; i < len; i++) g_lin[slave].lastData[i] = rxData[i];
    g_lin[slave].lastClassic = classic ? 1 : 0;
    g_lin[slave].lastDir = 0;
    g_lin[slave].lastTick = g_TickCount_1ms;
    g_lin[slave].lastOk = 1;
    g_lin[master].lastId = id6 & 0x3FU;
    g_lin[master].lastLen = len;
    for (i = 0; i < len; i++) g_lin[master].lastData[i] = data[i];
    g_lin[master].lastClassic = classic ? 1 : 0;
    g_lin[master].lastDir = 0;
    g_lin[master].lastTick = g_TickCount_1ms;
    g_lin[master].lastOk = 1;
    return 0;
}

/* Pairwise slave -> master (master header, slave responds, master verifies). */
int lin_xact_s2m(linChannel master, linChannel responder, uint8 id6,
                 const uint8 *data, uint8 len, uint8 classic)
{
    uint8 pid = lin_pid(id6);
    uint8 rxPid = 0, rxData[8];
    int i;

    if (master < LIN1 || master > LIN11 || responder < LIN1 || responder > LIN11) return -1;
    if (len < 1) len = 1;
    if (len > 8) len = 8;

    lin_arm_header(linSfr[responder]);
    if (lin_tx_header(linSfr[master], pid, &g_lin[master]) != 0) return -1;
    if (lin_poll_header(linSfr[responder], &rxPid, &g_lin[responder]) != 0 || rxPid != pid) return -1;
    lin_arm_response(linSfr[master], len, classic);
    if (lin_tx_response(linSfr[responder], data, len, classic, &g_lin[responder]) != 0) {
        IfxAsclin_clearAllFlags(linSfr[master]);
        return -1;
    }
    memset(rxData, 0, sizeof(rxData));
    if (lin_poll_response(linSfr[master], rxData, len, &g_lin[master]) != 0) return -1;
    for (i = 0; i < len; i++) {
        if (rxData[i] != data[i]) return -1;
    }
    g_lin[responder].lastId = id6 & 0x3FU;
    g_lin[responder].lastLen = len;
    for (i = 0; i < len; i++) g_lin[responder].lastData[i] = data[i];
    g_lin[responder].lastClassic = classic ? 1 : 0;
    g_lin[responder].lastDir = 1;
    g_lin[responder].lastTick = g_TickCount_1ms;
    g_lin[responder].lastOk = 1;
    g_lin[master].lastId = id6 & 0x3FU;
    g_lin[master].lastLen = len;
    for (i = 0; i < len; i++) g_lin[master].lastData[i] = rxData[i];
    g_lin[master].lastClassic = classic ? 1 : 0;
    g_lin[master].lastDir = 1;
    g_lin[master].lastTick = g_TickCount_1ms;
    g_lin[master].lastOk = 1;
    return 0;
}
/* ---------- full transactions ---------- */
int lin_xact_master_tx_mode(uint8 id6, const uint8 *data, uint8 len,
                            uint8 masterClassic, uint8 slaveClassic, uint32 *okMask)
{
    uint8 pid = lin_pid(id6);
    uint8 rxPid;
    uint8 rxData[8];
    linChannel ch;
    int fails = 0;
    uint32 mask = 0;
    int i;

    if (len < 1) len = 1;
    if (len > 8) len = 8;

    /* 1) arm all slaves for header */
    for (ch = LIN1; ch <= LIN10; ch++) lin_arm_header(linSfr[ch]);
    /* 2) master sends header */
    if (lin_tx_header(linSfr[LIN_MASTER_CH], pid, &g_lin[LIN_MASTER_CH]) != 0) {
        /* header itself failed: count all slaves failed */
        for (ch = LIN1; ch <= LIN10; ch++) {
            g_lin[ch].hdrErr++;
            g_lin[ch].timeoutErr++;
        }
        if (okMask) *okMask = 0;
        return 10;
    }
    /* 3) slaves collect header */
    for (ch = LIN1; ch <= LIN10; ch++) {
        if (lin_poll_header(linSfr[ch], &rxPid, &g_lin[ch]) != 0 || rxPid != pid) {
            fails++;
            continue;
        }
        mask |= (1u << ch);
    }
    if (fails) {
        /* still send response so bus settles; receivers ignore result */
        (void)lin_tx_response(linSfr[LIN_MASTER_CH], data, len, masterClassic, NULL);
        if (okMask) *okMask = 0;
        return fails;
    }
    /* 4) arm all slaves for response (slave checksum mode) */
    for (ch = LIN1; ch <= LIN10; ch++) lin_arm_response(linSfr[ch], len, slaveClassic);
    /* 5) master sends response (master checksum mode) */
    if (lin_tx_response(linSfr[LIN_MASTER_CH], data, len, masterClassic, &g_lin[LIN_MASTER_CH]) != 0) {
        for (ch = LIN1; ch <= LIN10; ch++) {
            g_lin[ch].respErr++;
            g_lin[ch].timeoutErr++;
        }
        if (okMask) *okMask = 0;
        return 10;
    }
    /* 6) slaves collect response + verify */
    mask = 0;
    fails = 0;
    for (ch = LIN1; ch <= LIN10; ch++) {
        memset(rxData, 0, sizeof(rxData));
        if (lin_poll_response(linSfr[ch], rxData, len, &g_lin[ch]) != 0) {
            fails++;
            continue;
        }
        for (i = 0; i < len; i++) {
            if (rxData[i] != data[i]) break;
        }
        if (i != len) {
            g_lin[ch].respErr++;
            fails++;
            continue;
        }
        mask |= (1u << ch);
        g_lin[ch].lastId = id6 & 0x3FU;
        g_lin[ch].lastLen = len;
        for (i = 0; i < len; i++) g_lin[ch].lastData[i] = rxData[i];
        g_lin[ch].lastClassic = slaveClassic ? 1 : 0;
        g_lin[ch].lastDir = 0;
        g_lin[ch].lastTick = g_TickCount_1ms;
        g_lin[ch].lastOk = 1;
    }
    g_lin[LIN_MASTER_CH].lastId = id6 & 0x3FU;
    g_lin[LIN_MASTER_CH].lastLen = len;
    for (i = 0; i < len; i++) g_lin[LIN_MASTER_CH].lastData[i] = data[i];
    g_lin[LIN_MASTER_CH].lastClassic = masterClassic ? 1 : 0;
    g_lin[LIN_MASTER_CH].lastDir = 0;
    g_lin[LIN_MASTER_CH].lastTick = g_TickCount_1ms;
    g_lin[LIN_MASTER_CH].lastOk = (fails == 0) ? 1 : 0;
    if (okMask) *okMask = mask;
    return fails;
}

int lin_xact_master_tx(uint8 id6, const uint8 *data, uint8 len, uint8 classic,
                       uint32 *okMask)
{
    return lin_xact_master_tx_mode(id6, data, len, classic, classic, okMask);
}

int lin_xact_slave_tx(uint8 id6, linChannel slave, const uint8 *data, uint8 len,
                      uint8 classic, uint32 *snooped)
{
    uint8 pid = lin_pid(id6);
    uint8 rxPid;
    uint8 rxData[8];
    linChannel ch;
    uint32 snoop = 0;
    int i, rc;

    if (slave < LIN1 || slave > LIN10) return -1;
    if (len < 1) len = 1;
    if (len > 8) len = 8;

    /* 1) arm all slaves for header */
    for (ch = LIN1; ch <= LIN10; ch++) lin_arm_header(linSfr[ch]);
    /* 2) master sends header */
    if (lin_tx_header(linSfr[LIN_MASTER_CH], pid, &g_lin[LIN_MASTER_CH]) != 0) {
        return -1;
    }
    /* 3) slaves collect header */
    for (ch = LIN1; ch <= LIN10; ch++) {
        if (lin_poll_header(linSfr[ch], &rxPid, &g_lin[ch]) != 0 || rxPid != pid) {
            if (ch == slave) return -1;
        }
    }
    /* 4) arm master + snooping slaves for response BEFORE the talker sends */
    lin_arm_response(linSfr[LIN_MASTER_CH], len, classic);
    for (ch = LIN1; ch <= LIN10; ch++) {
        if (ch != slave) lin_arm_response(linSfr[ch], len, classic);
    }
    /* 5) designated slave sends response */
    if (lin_tx_response(linSfr[slave], data, len, classic, &g_lin[slave]) != 0) {
        IfxAsclin_clearAllFlags(linSfr[LIN_MASTER_CH]);
        return -1;
    }
    /* 6) master collects response */
    memset(rxData, 0, sizeof(rxData));
    rc = lin_poll_response(linSfr[LIN_MASTER_CH], rxData, len, &g_lin[LIN_MASTER_CH]);
    if (rc != 0) {
        return -1;
    }
    for (i = 0; i < len; i++) {
        if (rxData[i] != data[i]) return -1;
    }
    /* 7) snoopers collect the same response */
    for (ch = LIN1; ch <= LIN10; ch++) {
        uint8 sb[8];
        int k;
        if (ch == slave) continue;
        memset(sb, 0, sizeof(sb));
        if (lin_poll_response(linSfr[ch], sb, len, &g_lin[ch]) != 0) continue;
        for (k = 0; k < len; k++) {
            if (sb[k] != data[k]) break;
        }
        if (k != len) {
            g_lin[ch].respErr++;
            continue;
        }
        snoop++;
        g_lin[ch].lastId = id6 & 0x3FU;
        g_lin[ch].lastLen = len;
        for (k = 0; k < len; k++) g_lin[ch].lastData[k] = sb[k];
        g_lin[ch].lastClassic = classic ? 1 : 0;
        g_lin[ch].lastDir = 1;
        g_lin[ch].lastTick = g_TickCount_1ms;
        g_lin[ch].lastOk = 1;
    }
    g_lin[slave].lastId = id6 & 0x3FU;
    g_lin[slave].lastLen = len;
    for (i = 0; i < len; i++) g_lin[slave].lastData[i] = data[i];
    g_lin[slave].lastClassic = classic ? 1 : 0;
    g_lin[slave].lastDir = 1;
    g_lin[slave].lastTick = g_TickCount_1ms;
    g_lin[slave].lastOk = 1;
    g_lin[LIN_MASTER_CH].lastId = id6 & 0x3FU;
    g_lin[LIN_MASTER_CH].lastLen = len;
    for (i = 0; i < len; i++) g_lin[LIN_MASTER_CH].lastData[i] = rxData[i];
    g_lin[LIN_MASTER_CH].lastClassic = classic ? 1 : 0;
    g_lin[LIN_MASTER_CH].lastDir = 1;
    g_lin[LIN_MASTER_CH].lastTick = g_TickCount_1ms;
    g_lin[LIN_MASTER_CH].lastOk = 1;
    if (snooped) *snooped = snoop;
    return 0;
}

/* ---------- raw primitives for error-injection tests ---------- */
int lin_raw_master_header(uint8 pid)
{
    return lin_tx_header(linSfr[LIN_MASTER_CH], pid, &g_lin[LIN_MASTER_CH]);
}

int lin_raw_master_response(const uint8 *data, uint8 len, uint8 classic)
{
    if (len < 1) len = 1;
    if (len > 8) len = 8;
    return lin_tx_response(linSfr[LIN_MASTER_CH], data, len, classic, &g_lin[LIN_MASTER_CH]);
}

void lin_slave_arm_header(linChannel ch)
{
    if (ch < LIN1 || ch > LIN11) return;
    lin_arm_header(linSfr[ch]);
}

void lin_slave_arm_response(linChannel ch, uint8 len, uint8 classic)
{
    if (ch < LIN1 || ch > LIN11) return;
    lin_arm_response(linSfr[ch], len, classic);
}

int lin_slave_poll_response(linChannel ch, uint8 *data, uint8 len)
{
    if (ch < LIN1 || ch > LIN11) return -1;
    return lin_poll_response(linSfr[ch], data, len, &g_lin[ch]);
}

int lin_slave_poll_header(linChannel ch, uint8 *pid)
{
    if (ch < LIN1 || ch > LIN11) return -1;
    return lin_poll_header(linSfr[ch], pid, &g_lin[ch]);
}

void lin_master_arm_response(uint8 len, uint8 classic)
{
    lin_arm_response(linSfr[LIN_MASTER_CH], len, classic);
}

int lin_master_poll_response(uint8 *data, uint8 len)
{
    return lin_poll_response(linSfr[LIN_MASTER_CH], data, len, &g_lin[LIN_MASTER_CH]);
}

void lin_probe_tx_toggle(linChannel ch, uint8 n)
{
    uint8 i;
    if (ch < LIN1 || ch > LIN11) return;
    if (n == 0) n = 10;
    if (n > 50) n = 50;
    /* TX pin -> GPIO output, toggle ~5 Hz */
    IfxPort_setPinModeOutput(linPins[ch].tx->pin.port, linPins[ch].tx->pin.pinIndex,
                             IfxPort_OutputMode_pushPull, IfxPort_OutputIdx_general);
    for (i = 0; i < n; i++) {
        uint32 t0 = g_TickCount_1ms;
        IfxPort_togglePin(linPins[ch].tx->pin.port, linPins[ch].tx->pin.pinIndex);
        while ((g_TickCount_1ms - t0) < 100u) { }
    }
    /* restore full LIN configuration */
    lin12_init_all(g_linBaud);
}

int lin_bus_activity(uint8 pid, uint32 *sawMask, uint8 *txSawLow, uint8 *txSawHigh)
{
    Ifx_ASCLIN *sfr = linSfr[LIN_MASTER_CH];
    uint8 b = pid;
    uint32 t0 = g_TickCount_1ms;
    uint32 mask = 0;
    uint8 low = 0, high = 0;
    linChannel ch;
    int rc = -1;

    IfxAsclin_clearAllFlags(sfr);
    IfxAsclin_enableRxFifoInlet(sfr, FALSE);
    IfxAsclin_flushTxFifo(sfr);
    IfxAsclin_enableTxFifoOutlet(sfr, TRUE);
    IfxAsclin_write8(sfr, &b, 1U);
    IfxAsclin_setTransmitHeaderRequestFlag(sfr);
    while (!IfxAsclin_getTxHeaderEndFlagStatus(sfr)) {
        /* NOTE: getPinState returns boolean (1/0); compare with FALSE/TRUE,
         * NOT with IfxPort_State_low (0x10000) which never matches! */
        boolean txLow = (IfxPort_getPinState(linPins[LIN_MASTER_CH].tx->pin.port,
                                             linPins[LIN_MASTER_CH].tx->pin.pinIndex)
                         == FALSE) ? TRUE : FALSE;
        if (txLow) low = 1;
        else high = 1;
        for (ch = LIN1; ch <= LIN10; ch++) {
            boolean rxLow = (IfxPort_getPinState(linPins[ch].rx->pin.port,
                                                 linPins[ch].rx->pin.pinIndex)
                             == FALSE) ? TRUE : FALSE;
            if (rxLow) mask |= (1u << ch);
        }
        if (IfxAsclin_getHeaderTimeoutFlagStatus(sfr) ||
            IfxAsclin_getFrameErrorFlagStatus(sfr) ||
            IfxAsclin_getCollisionDetectionErrorFlagStatus(sfr) ||
            IfxAsclin_getLinParityErrorFlagStatus(sfr)) {
            break;
        }
        if ((g_TickCount_1ms - t0) > LIN_HDR_TIMEOUT_MS) break;
    }
    if (IfxAsclin_getTxHeaderEndFlagStatus(sfr)) {
        IfxAsclin_clearTxHeaderEndFlag(sfr);
        g_lin[LIN_MASTER_CH].txHdr++;
        rc = 0;
    } else {
        g_lin[LIN_MASTER_CH].hdrErr++;
    }
    IfxAsclin_clearAllFlags(sfr);
    if (sawMask) *sawMask = mask;
    if (txSawLow) *txSawLow = low;
    if (txSawHigh) *txSawHigh = high;
    return rc;
}

/* STM busy-wait in ticks (100 MHz STM0 -> 10 ns/tick, unsigned wrap-safe). */
static void lin_stm_wait_ticks(uint32 ticks)
{
    uint32 t0 = IfxStm_getLower(&MODULE_STM0);
    while ((IfxStm_getLower(&MODULE_STM0) - t0) < ticks) { }
}

uint32 lin_rx_levels(void)
{
    uint32 mask = 0;
    linChannel ch;
    for (ch = LIN1; ch <= LIN11; ch++) {
        boolean low = (IfxPort_getPinState(linPins[ch].rx->pin.port,
                                           linPins[ch].rx->pin.pinIndex)
                       == FALSE) ? TRUE : FALSE;
        if (low) mask |= (1u << ch);
    }
    return mask;
}

void lin_passive_census(uint32 ms, uint32 edgeCnt[LIN_NUM], uint32 *lowMask)
{
    uint32 t0, last[LIN_NUM], cnt[LIN_NUM], low = 0;
    linChannel ch;
    int i;
    if (ms < 100u) ms = 100u;
    if (ms > 10000u) ms = 10000u;
    for (i = 0; i < LIN_NUM; i++) { cnt[i] = 0; last[i] = 1; }
    /* snapshot initial levels */
    for (ch = LIN1; ch <= LIN11; ch++) {
        last[ch] = (IfxPort_getPinState(linPins[ch].rx->pin.port,
                                        linPins[ch].rx->pin.pinIndex)
                    == FALSE) ? 0u : 1u;
        if (last[ch] == 0) low |= (1u << ch);
    }
    t0 = g_TickCount_1ms;
    while ((g_TickCount_1ms - t0) < ms) {
        for (ch = LIN1; ch <= LIN11; ch++) {
            uint32 lvl = (IfxPort_getPinState(linPins[ch].rx->pin.port,
                                              linPins[ch].rx->pin.pinIndex)
                          == FALSE) ? 0u : 1u;
            if (lvl == 0) low |= (1u << ch);
            if (lvl != last[ch]) { cnt[ch]++; last[ch] = lvl; }
        }
    }
    for (i = 0; i < LIN_NUM; i++) {
        if (edgeCnt) edgeCnt[i] = (i >= LIN1 && i <= LIN11) ? cnt[i] : 0;
    }
    if (lowMask) *lowMask = low;
}

void lin_dominant_hold(linChannel ch, uint32 *earlyMask, uint32 *lateMask)
{
    uint32 t0;
    if (ch < LIN1 || ch > LIN11) return;
    /* TX net -> GPIO, drive dominant (TLIN TXD low) */
    IfxPort_setPinModeOutput(linPins[ch].tx->pin.port, linPins[ch].tx->pin.pinIndex,
                             IfxPort_OutputMode_pushPull, IfxPort_OutputIdx_general);
    IfxPort_setPinLow(linPins[ch].tx->pin.port, linPins[ch].tx->pin.pinIndex);
    t0 = g_TickCount_1ms;
    while ((g_TickCount_1ms - t0) < 2u) { }
    if (earlyMask) *earlyMask = lin_rx_levels();
    t0 = g_TickCount_1ms;
    while ((g_TickCount_1ms - t0) < 300u) { }
    if (lateMask) *lateMask = lin_rx_levels();
    /* release + recover (DTO clears on TXD rising edge) */
    IfxPort_setPinHigh(linPins[ch].tx->pin.port, linPins[ch].tx->pin.pinIndex);
    t0 = g_TickCount_1ms;
    while ((g_TickCount_1ms - t0) < 50u) { }
    /* restore full LIN configuration (pin mux + ASCLIN) */
    lin12_init_all(g_linBaud);
}

void lin_dominant_fast(linChannel ch, uint8 *txSelfLow, uint32 *rxMask)
{
    Ifx_P *txPort;
    uint8 txPin;
    uint32 t0ms;
    uint32 rx = 0;
    uint8 selfLow = 0;
    linChannel c;

    if (ch < LIN1 || ch > LIN11) return;
    txPort = linPins[ch].tx->pin.port;
    txPin = linPins[ch].tx->pin.pinIndex;
    IfxPort_setPinModeOutput(txPort, txPin,
                             IfxPort_OutputMode_pushPull, IfxPort_OutputIdx_general);
    IfxPort_setPinLow(txPort, txPin);
    /* ~5 ms STM window (DTO min 20 ms, so bus must stay dominant throughout) */
    t0ms = g_TickCount_1ms;
    while ((g_TickCount_1ms - t0ms) < 5u) {
        if (IfxPort_getPinState(txPort, txPin) == FALSE) selfLow = 1;
        for (c = LIN1; c <= LIN11; c++) {
            if (IfxPort_getPinState(linPins[c].rx->pin.port,
                                    linPins[c].rx->pin.pinIndex) == FALSE) {
                rx |= (1u << c);
            }
        }
    }
    /* snapshot PCR + IN/OUT mid-hold (globals for shell printout) */
    g_linHoldIOC = txPort->IOCR0.U;
    g_linHoldIN = txPort->IN.U;
    g_linHoldOUT = txPort->OUT.U;
    IfxPort_setPinHigh(txPort, txPin);
    t0ms = g_TickCount_1ms;
    while ((g_TickCount_1ms - t0ms) < 50u) { }
    lin12_init_all(g_linBaud);
    if (txSelfLow) *txSelfLow = selfLow;
    if (rxMask) *rxMask = rx;
}

void lin_ac_census(linChannel master, uint8 pid, uint32 edgeCnt[LIN_NUM])
{
    Ifx_ASCLIN *sfr;
    uint8 b = pid;
    uint32 t0;
    uint32 last[LIN_NUM], cnt[LIN_NUM];
    linChannel ch;
    int i;

    if (master < LIN1 || master > LIN11) return;
    for (i = 0; i < LIN_NUM; i++) { cnt[i] = 0; last[i] = 1; }
    sfr = linSfr[master];

    IfxAsclin_clearAllFlags(sfr);
    IfxAsclin_enableRxFifoInlet(sfr, FALSE);
    IfxAsclin_flushTxFifo(sfr);
    IfxAsclin_enableTxFifoOutlet(sfr, TRUE);
    IfxAsclin_write8(sfr, &b, 1U);
    IfxAsclin_setTransmitHeaderRequestFlag(sfr);
    t0 = g_TickCount_1ms;
    while (!IfxAsclin_getTxHeaderEndFlagStatus(sfr)) {
        for (ch = LIN1; ch <= LIN11; ch++) {
            uint32 lvl = (IfxPort_getPinState(linPins[ch].rx->pin.port,
                                              linPins[ch].rx->pin.pinIndex)
                          == FALSE) ? 0u : 1u;
            if (lvl != last[ch]) {
                cnt[ch]++;
                last[ch] = lvl;
            }
        }
        if ((g_TickCount_1ms - t0) > LIN_HDR_TIMEOUT_MS) break;
    }
    IfxAsclin_clearAllFlags(sfr);
    /* drain ~2 ms more to catch trailing edges */
    t0 = g_TickCount_1ms;
    while ((g_TickCount_1ms - t0) < 2u) {
        for (ch = LIN1; ch <= LIN11; ch++) {
            uint32 lvl = (IfxPort_getPinState(linPins[ch].rx->pin.port,
                                              linPins[ch].rx->pin.pinIndex)
                          == FALSE) ? 0u : 1u;
            if (lvl != last[ch]) {
                cnt[ch]++;
                last[ch] = lvl;
            }
        }
    }
    for (i = 0; i < LIN_NUM; i++) {
        if (edgeCnt) edgeCnt[i] = (i >= LIN1 && i <= LIN11) ? cnt[i] : 0;
    }
    g_lin[master].txHdr++;
}

uint32 lin_pulse_capture(linChannel master, linChannel rxch, uint8 pid,
                         uint32 stamps[64])
{
    Ifx_ASCLIN *sfr;
    Ifx_P *port;
    uint8 pin;
    uint8 b = pid;
    uint32 t0, n = 0, last;
    int i;

    if (master < LIN1 || master > LIN11 || rxch < LIN1 || rxch > LIN11) return 0;
    sfr = linSfr[master];
    port = linPins[rxch].rx->pin.port;
    pin = linPins[rxch].rx->pin.pinIndex;

    IfxAsclin_clearAllFlags(sfr);
    IfxAsclin_enableRxFifoInlet(sfr, FALSE);
    IfxAsclin_flushTxFifo(sfr);
    IfxAsclin_enableTxFifoOutlet(sfr, TRUE);
    last = (IfxPort_getPinState(port, pin) == FALSE) ? 0u : 1u;
    IfxAsclin_write8(sfr, &b, 1U);
    IfxAsclin_setTransmitHeaderRequestFlag(sfr);
    t0 = g_TickCount_1ms;
    while (!IfxAsclin_getTxHeaderEndFlagStatus(sfr)) {
        uint32 lvl = (IfxPort_getPinState(port, pin) == FALSE) ? 0u : 1u;
        if (lvl != last && n < 64) {
            stamps[n++] = IfxStm_getLower(&MODULE_STM0);
            last = lvl;
        }
        if ((g_TickCount_1ms - t0) > LIN_HDR_TIMEOUT_MS) break;
    }
    IfxAsclin_clearAllFlags(sfr);
    t0 = g_TickCount_1ms;
    while ((g_TickCount_1ms - t0) < 3u && n < 64) {
        uint32 lvl = (IfxPort_getPinState(port, pin) == FALSE) ? 0u : 1u;
        if (lvl != last) {
            stamps[n++] = IfxStm_getLower(&MODULE_STM0);
            last = lvl;
        }
    }
    g_lin[master].txHdr++;
    for (i = 0; i < 0; i++) { (void)i; }
    return n;
}

int lin_rawhdr_forensic(linChannel master, linChannel slave, uint8 pid,
                        uint8 *rxPid, uint32 *flagSnap)
{
    Ifx_ASCLIN *msfr, *ssfr;
    uint8 b = pid, got = 0;
    uint32 t0;
    int rc = -1;

    if (master < LIN1 || master > LIN11 || slave < LIN1 || slave > LIN11) return -1;
    msfr = linSfr[master];
    ssfr = linSfr[slave];

    lin_arm_header(ssfr);
    /* master header TX (same as lin_tx_header, stats on master) */
    IfxAsclin_clearAllFlags(msfr);
    IfxAsclin_enableRxFifoInlet(msfr, FALSE);
    IfxAsclin_flushTxFifo(msfr);
    IfxAsclin_enableTxFifoOutlet(msfr, TRUE);
    IfxAsclin_write8(msfr, &b, 1U);
    IfxAsclin_setTransmitHeaderRequestFlag(msfr);
    t0 = g_TickCount_1ms;
    while (!IfxAsclin_getTxHeaderEndFlagStatus(msfr)) {
        if ((g_TickCount_1ms - t0) > LIN_HDR_TIMEOUT_MS) break;
    }
    if (IfxAsclin_getTxHeaderEndFlagStatus(msfr)) {
        IfxAsclin_clearTxHeaderEndFlag(msfr);
        g_lin[master].txHdr++;
    } else {
        g_lin[master].hdrErr++;
    }
    IfxAsclin_clearAllFlags(msfr);
    /* RHE-only poll on slave for 100 ms, then snapshot FLAGS (no clear) */
    t0 = g_TickCount_1ms;
    while (!IfxAsclin_getRxHeaderEndFlagStatus(ssfr)) {
        if ((g_TickCount_1ms - t0) > 100u) break;
    }
    if (flagSnap) *flagSnap = ssfr->FLAGS.U;
    if (IfxAsclin_getRxHeaderEndFlagStatus(ssfr)) {
        IfxAsclin_clearRxHeaderEndFlag(ssfr);
        IfxAsclin_read8(ssfr, &got, 1U);
        g_lin[slave].rxHdr++;
        if (rxPid) *rxPid = got;
        rc = 0;
    }
    return rc;
}

void lin_tx_trace(linChannel master, uint8 pid, uint32 flagsLog[60],
                  uint32 fifoLog[60])
{
    Ifx_ASCLIN *sfr;
    uint8 b = pid;
    int i;

    if (master < LIN1 || master > LIN11) return;
    sfr = linSfr[master];
    IfxAsclin_clearAllFlags(sfr);
    IfxAsclin_enableRxFifoInlet(sfr, FALSE);
    IfxAsclin_flushTxFifo(sfr);
    IfxAsclin_enableTxFifoOutlet(sfr, TRUE);
    IfxAsclin_write8(sfr, &b, 1U);
    IfxAsclin_setTransmitHeaderRequestFlag(sfr);
    for (i = 0; i < 60; i++) {
        uint32 t1 = IfxStm_getLower(&MODULE_STM0);
        while ((IfxStm_getLower(&MODULE_STM0) - t1) < 10000u) { } /* ~100 us */
        if (flagsLog) flagsLog[i] = sfr->FLAGS.U;
        if (fifoLog) fifoLog[i] = sfr->TXFIFOCON.U;
    }
    IfxAsclin_clearAllFlags(sfr);
}

int lin_bb_header(linChannel slave, uint8 pid, uint8 *rxPid)
{
    Ifx_ASCLIN *sfr;
    Ifx_P *port;
    uint8 pin;
    uint32 freq, bitTicks;
    uint8 b;
    int i, rc = -1;
    uint32 t0;

    if (slave < LIN1 || slave > LIN11) return -1;
    sfr = linSfr[slave];
    port = linPins[slave].rx->pin.port;
    pin = linPins[slave].rx->pin.pinIndex;

    freq = IfxStm_getFrequency(&MODULE_STM0);
    if (freq < 1000000u) freq = 100000000u;
    bitTicks = freq / (uint32)g_linBaud;   /* e.g. 5208 @19200/100MHz */

    /* arm slave header reception */
    lin_arm_header(sfr);

    /* RX net -> GPIO output, idle recessive (high) */
    IfxPort_setPinModeOutput(port, pin, IfxPort_OutputMode_pushPull, IfxPort_OutputIdx_general);
    IfxPort_setPinHigh(port, pin);
    t0 = g_TickCount_1ms;
    while ((g_TickCount_1ms - t0) < 3u) { }

    /* break: 14 bits dominant + 1 bit delimiter */
    IfxPort_setPinLow(port, pin);
    lin_stm_wait_ticks(bitTicks * 14u);
    IfxPort_setPinHigh(port, pin);
    lin_stm_wait_ticks(bitTicks);

    /* sync 0x55 + PID, 8N1 LSB-first */
    for (b = 0; b < 2; b++) {
        uint8 byte = (b == 0) ? 0x55u : pid;
        IfxPort_setPinLow(port, pin);              /* start */
        lin_stm_wait_ticks(bitTicks);
        for (i = 0; i < 8; i++) {
            if (byte & (1u << i)) IfxPort_setPinHigh(port, pin);
            else IfxPort_setPinLow(port, pin);
            lin_stm_wait_ticks(bitTicks);
        }
        IfxPort_setPinHigh(port, pin);             /* stop */
        lin_stm_wait_ticks(bitTicks);
    }

    /* let the ASCLIN latch RHE, then sample before re-init clears it */
    t0 = g_TickCount_1ms;
    while ((g_TickCount_1ms - t0) < 5u) { }
    if (IfxAsclin_getRxHeaderEndFlagStatus(sfr)) {
        uint8 got = 0;
        IfxAsclin_clearRxHeaderEndFlag(sfr);
        IfxAsclin_read8(sfr, &got, 1U);
        g_lin[slave].rxHdr++;
        if (rxPid) *rxPid = got;
        rc = (got == pid) ? 0 : -2;
    } else {
        g_lin[slave].hdrErr++;
        g_lin[slave].timeoutErr++;
    }

    /* restore full LIN configuration (pin mux + ASCLIN) */
    lin12_init_all(g_linBaud);
    return rc;
}

int lin_master_loopback(uint8 id6, const uint8 *data, uint8 len, uint8 classic,
                        uint8 *treSeen, uint32 *flagSnap)
{
    Ifx_ASCLIN *sfr = linSfr[LIN_MASTER_CH];
    uint8 pid = lin_pid(id6);
    uint8 b = pid;
    uint8 rxPid = 0, rxData[8];
    uint32 t0;
    uint8 tre = 0;
    int i;

    if (len < 1) len = 1;
    if (len > 8) len = 8;

    IfxAsclin_setDataLength(sfr, (IfxAsclin_DataLength)(len - 1));
    IfxAsclin_setChecksumMode(sfr, classic ? IfxAsclin_Checksum_classic : IfxAsclin_Checksum_enhanced);
    IfxAsclin_clearAllFlags(sfr);
    IfxAsclin_flushRxFifo(sfr);
    IfxAsclin_flushTxFifo(sfr);
    /* keep BOTH directions open: TX header goes out, looped-back header
     * comes in through the transceiver + bus */
    IfxAsclin_enableRxFifoInlet(sfr, TRUE);
    IfxAsclin_enableTxFifoOutlet(sfr, TRUE);
    IfxAsclin_write8(sfr, &b, 1U);
    IfxAsclin_setTransmitHeaderRequestFlag(sfr);

    /* wait for EITHER own-TX-done or looped-back-header, up to 50 ms */
    t0 = g_TickCount_1ms;
    while (!IfxAsclin_getRxHeaderEndFlagStatus(sfr)) {
        if (IfxAsclin_getHeaderTimeoutFlagStatus(sfr) ||
            IfxAsclin_getFrameErrorFlagStatus(sfr) ||
            IfxAsclin_getCollisionDetectionErrorFlagStatus(sfr) ||
            IfxAsclin_getLinParityErrorFlagStatus(sfr)) {
            break;
        }
        if ((g_TickCount_1ms - t0) > LIN_HDR_TIMEOUT_MS) break;
    }
    if (!IfxAsclin_getRxHeaderEndFlagStatus(sfr)) {
        g_lin[LIN_MASTER_CH].hdrErr++;
        g_lin[LIN_MASTER_CH].timeoutErr++;
        IfxAsclin_clearAllFlags(sfr);
        return -1;
    }
    IfxAsclin_clearRxHeaderEndFlag(sfr);
    IfxAsclin_clearTxHeaderEndFlag(sfr);
    IfxAsclin_read8(sfr, &rxPid, 1U);
    g_lin[LIN_MASTER_CH].rxHdr++;
    if (rxPid != pid) {
        g_lin[LIN_MASTER_CH].hdrErr++;
        g_lin[LIN_MASTER_CH].parityErr++;
        IfxAsclin_clearAllFlags(sfr);
        return -2;
    }

    /* now the response: transmit it while RX stays armed, catch the echo */
    IfxAsclin_setDataLength(sfr, (IfxAsclin_DataLength)(len - 1));
    IfxAsclin_setChecksumMode(sfr, classic ? IfxAsclin_Checksum_classic : IfxAsclin_Checksum_enhanced);
    IfxAsclin_clearAllFlags(sfr);
    IfxAsclin_flushRxFifo(sfr);
    IfxAsclin_flushTxFifo(sfr);
    IfxAsclin_enableRxFifoInlet(sfr, TRUE);
    IfxAsclin_enableTxFifoOutlet(sfr, TRUE);
    IfxAsclin_write8(sfr, (uint8 *)data, len);
    IfxAsclin_setTransmitResponseRequestFlag(sfr);
    t0 = g_TickCount_1ms;
    while (!IfxAsclin_getRxResponseEndFlagStatus(sfr)) {
        if (IfxAsclin_getTxResponseEndFlagStatus(sfr)) tre = 1;
        if (IfxAsclin_getRxFifoOverflowFlagStatus(sfr) ||
            IfxAsclin_getFrameErrorFlagStatus(sfr) ||
            IfxAsclin_getCollisionDetectionErrorFlagStatus(sfr) ||
            IfxAsclin_getLinChecksumErrorFlagStatus(sfr) ||
            IfxAsclin_getResponseTimeoutFlagStatus(sfr)) {
            break;
        }
        if ((g_TickCount_1ms - t0) > LIN_RESP_TIMEOUT_MS) break;
    }
    if (IfxAsclin_getTxResponseEndFlagStatus(sfr)) tre = 1;
    if (treSeen) *treSeen = tre;
    if (flagSnap) *flagSnap = sfr->FLAGS.U;
    if (!IfxAsclin_getRxResponseEndFlagStatus(sfr)) {
        g_lin[LIN_MASTER_CH].respErr++;
        g_lin[LIN_MASTER_CH].timeoutErr++;
        IfxAsclin_clearAllFlags(sfr);
        return -4;
    }
    IfxAsclin_clearRxResponseEndFlag(sfr);
    IfxAsclin_clearTxResponseEndFlag(sfr);
    memset(rxData, 0, sizeof(rxData));
    IfxAsclin_read8(sfr, rxData, len);
    g_lin[LIN_MASTER_CH].rxResp++;
    g_lin[LIN_MASTER_CH].txResp++;
    for (i = 0; i < len; i++) {
        if (rxData[i] != data[i]) {
            g_lin[LIN_MASTER_CH].respErr++;
            IfxAsclin_clearAllFlags(sfr);
            return -5;
        }
    }
    IfxAsclin_clearAllFlags(sfr);
    return 0;
}
