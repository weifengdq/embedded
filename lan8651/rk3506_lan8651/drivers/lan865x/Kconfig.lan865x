## lan8651/rk3506_lan8651/drivers/lan865x/Kconfig.lan865x
```kconfig
# SPDX-License-Identifier: GPL-2.0-only
#
# Microchip LAN865x Driver Support
#

if NET_VENDOR_MICROCHIP

config LAN865X
	tristate "LAN865x support"
	depends on SPI
	select OA_TC6
	help
	  Support for the Microchip LAN8650/1 Rev.B0/B1 MACPHY Ethernet chip.
	  It is a 10BASE-T1S MAC-PHY with an OPEN Alliance TC6 SPI interface.

	  To compile this driver as a module, choose M here. The module will be
	  called lan865x.

endif # NET_VENDOR_MICROCHIP
```
